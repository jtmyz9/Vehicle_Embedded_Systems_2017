// File generated 2/9/2017 3:34:00 PM
// Warning! This is a generated file, any manual changes will be
// lost during the next generation.

#constant  Strings1Count    1
#constant  Strings1Size     7
#constant  Strings2Count    1
#constant  Strings2Size     7
#constant  Strings3Count    1
#constant  Strings3Size     7
// object indexes into ImageControl
#CONST
    iRPM            // offset 0x0
    iiRPM           // offset 0x18600
    iStatictext1    // offset 0x49200
    iLeddigits1     // offset 0x4A000
    iiLeddigits1    // offset 0x4C400
    iLeddigits8     // offset 0x53800
    iiLeddigits8    // offset 0x56A00
    iLeddigits9     // offset 0x61000
    iiLeddigits9    // offset 0x62E00
    iLeddigits10    // offset 0x6C400
    iiLeddigits10   // offset 0x6E600
    iLeddigits2     // offset 0x78A00
    iiLeddigits2    // offset 0x8BA00
    iStatictext2    // offset 0xB1A00
    iLeddigits3     // offset 0xB2200
    iiLeddigits3    // offset 0xB4800
    iLeddigits4     // offset 0xBC200
    iiLeddigits4    // offset 0xBD400
    iLeddigits5     // offset 0xC2A00
    iiLeddigits5    // offset 0xC3A00
    iLeddigits6     // offset 0xC8800
    iiLeddigits6    // offset 0xC9A00
    iLeddigits7     // offset 0xCF000
    iiLeddigits7    // offset 0xD0000
    irpm            // offset 0xD4E00
    iirpm           // offset 0xED400
    itestdigits     // offset 0x11E000
    iitestdigits    // offset 0x121000
    iImage1         // offset 0x128800
#END

#constant  Strings1StartH   0x0
#constant  Strings1StartL   0x0
#constant  Strings2StartH   0x0
#constant  Strings2StartL   0x200
#constant  Strings3StartH   0x0
#constant  Strings3StartL   0x400
#IFNOT EXISTS NOGLOBALS
var hndl ;
#ENDIF
